/ {
    oled_display {
        compatible = "ssd1306";
        label = "OLED_DISPLAY";
        i2c = <&i2c1>;
        width = <128>;
        height = <32>;
    };

    battery_monitor {
        compatible = "zmk,battery";
        label = "BATTERY";
        io-channels = <&adc 0>;
        full-cell-microvolt = <4200000>;
        empty-cell-microvolt = <3300000>;
    };

    rgb_underglow {
        compatible = "zmk,rgb-underglow";
        label = "RGB_UNDERGLOW";
        chain-length = <30>;
        io-channels = <&gpio0 13 GPIO_ACTIVE_HIGH>;
    };
};
